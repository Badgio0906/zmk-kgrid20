## config/boards/shields/k_grid/Kconfig.defconfig
```kconfig
if SHIELD_K_GRID_LEFT

config ZMK_SPLIT_ROLE_CENTRAL
    default y

endif

if SHIELD_K_GRID_RIGHT

config ZMK_SPLIT_ROLE_CENTRAL
    default n

endif

if SHIELD_K_GRID_LEFT || SHIELD_K_GRID_RIGHT

config ZMK_KEYBOARD_NAME
    default "kgrid20"

config ZMK_SPLIT
    default y

config BT
    default y

config ZMK_BLE
    default y

endif
```

## config/boards/shields/k_grid/Kconfig.shield
```kconfig
config SHIELD_K_GRID_LEFT
    def_bool $(shields_list_contains,k_grid_left)

config SHIELD_K_GRID_RIGHT
    def_bool $(shields_list_contains,k_grid_right)
```
